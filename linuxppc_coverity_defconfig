## linuxppc_coverity_defconfig
```kconfig
CONFIG_ACENIC=m
CONFIG_ACENIC_OMIT_TIGON_I=y
CONFIG_ADB_PMU=y
CONFIG_ATA=y
CONFIG_ATA_GENERIC=y
CONFIG_AUDIT=y
CONFIG_AUTOFS4_FS=m
CONFIG_BE2ISCSI=m
CONFIG_BE2NET=m
CONFIG_BINFMT_MISC=m
CONFIG_BLK_DEV_AMD74XX=y
CONFIG_BLK_DEV_DM=y
CONFIG_BLK_DEV_FD=y
CONFIG_BLK_DEV_GENERIC=y
CONFIG_BLK_DEV_IDECD=y
CONFIG_BLK_DEV_INITRD=y
CONFIG_BLK_DEV_IO_TRACE=y
CONFIG_BLK_DEV_LOOP=y
CONFIG_BLK_DEV_MD=y
CONFIG_BLK_DEV_NBD=m
CONFIG_BLK_DEV_NVME=y
CONFIG_BLK_DEV_RAM=y
CONFIG_BLK_DEV_RAM_SIZE=65536
CONFIG_BLK_DEV_SD=y
CONFIG_BLK_DEV_SR=y
CONFIG_BLK_DEV_SR_VENDOR=y
CONFIG_BNX2X=m
CONFIG_BONDING=m
CONFIG_BOOTX_TEXT=y
CONFIG_BPF_JIT=y
CONFIG_BPF_SYSCALL=y
CONFIG_BRIDGE=m
CONFIG_BROADCOM_PHY=m
CONFIG_BTRFS_FS=m
CONFIG_BTRFS_FS_POSIX_ACL=y
CONFIG_CGROUPS=y
CONFIG_CGROUP_BPF=y
CONFIG_CGROUP_CPUACCT=y
CONFIG_CGROUP_DEVICE=y
CONFIG_CGROUP_FREEZER=y
CONFIG_CGROUP_PERF=y
CONFIG_CGROUP_SCHED=y
CONFIG_CHELSIO_T1=m
CONFIG_CHR_DEV_SG=y
CONFIG_CHR_DEV_ST=m
CONFIG_CIFS=m
CONFIG_CIFS_POSIX=y
CONFIG_CIFS_XATTR=y
CONFIG_CODE_PATCHING_SELFTEST=y
CONFIG_CPUSETS=y
CONFIG_CPU_FREQ_DEFAULT_GOV_ONDEMAND=y
CONFIG_CPU_FREQ_PMAC64=y
CONFIG_CPU_IDLE=y
CONFIG_CPU_LITTLE_ENDIAN=y
CONFIG_CRAMFS=m
CONFIG_CRASH_DUMP=y
CONFIG_CRYPTO_ANUBIS=m
CONFIG_CRYPTO_BLOWFISH=m
CONFIG_CRYPTO_CAST6=m
CONFIG_CRYPTO_CCM=m
CONFIG_CRYPTO_CRC32C_VPMSUM=m
CONFIG_CRYPTO_DEV_NX=y
CONFIG_CRYPTO_DEV_NX_ENCRYPT=m
CONFIG_CRYPTO_DEV_VMX=y
CONFIG_CRYPTO_HMAC=y
CONFIG_CRYPTO_KHAZAD=m
CONFIG_CRYPTO_LZO=m
CONFIG_CRYPTO_MD5_PPC=m
CONFIG_CRYPTO_MICHAEL_MIC=m
CONFIG_CRYPTO_PCBC=m
CONFIG_CRYPTO_SALSA20=m
CONFIG_CRYPTO_SERPENT=m
CONFIG_CRYPTO_SHA1_PPC=m
CONFIG_CRYPTO_SHA256=y
CONFIG_CRYPTO_TEA=m
CONFIG_CRYPTO_TEST=m
CONFIG_CRYPTO_TGR192=m
CONFIG_CRYPTO_TWOFISH=m
CONFIG_CRYPTO_WP512=m
CONFIG_DEBUG_KERNEL=y
CONFIG_DEBUG_MUTEXES=y
CONFIG_DEBUG_STACKOVERFLOW=y
CONFIG_DEBUG_STACK_USAGE=y
CONFIG_DEVTMPFS=y
CONFIG_DEVTMPFS_MOUNT=y
CONFIG_DM_CRYPT=m
CONFIG_DM_MIRROR=m
CONFIG_DM_MULTIPATH=m
CONFIG_DM_MULTIPATH_QL=m
CONFIG_DM_MULTIPATH_ST=m
CONFIG_DM_SNAPSHOT=m
CONFIG_DM_THIN_PROVISIONING=m
CONFIG_DM_UEVENT=y
CONFIG_DM_ZERO=m
CONFIG_DRM=y
CONFIG_DRM_AST=y
CONFIG_DTL=y
CONFIG_DUMMY=m
CONFIG_E1000=y
CONFIG_E1000E=y
CONFIG_E100=y
CONFIG_EDAC=y
CONFIG_EDAC_PASEMI=y
CONFIG_EHEA=m
CONFIG_ELECTRA_CF=y
CONFIG_EXT2_FS=y
CONFIG_EXT2_FS_POSIX_ACL=y
CONFIG_EXT2_FS_SECURITY=y
CONFIG_EXT2_FS_XATTR=y
CONFIG_EXT4_FS=y
CONFIG_EXT4_FS_POSIX_ACL=y
CONFIG_EXT4_FS_SECURITY=y
CONFIG_FB=y
CONFIG_FB_IBM_GXT4500=y
CONFIG_FB_MATROX=y
CONFIG_FB_MATROX_G=y
CONFIG_FB_MATROX_I2C=m
CONFIG_FB_MATROX_MAVEN=m
CONFIG_FB_MATROX_MILLENIUM=y
CONFIG_FB_MATROX_MYSTIQUE=y
CONFIG_FB_OF=y
CONFIG_FB_PS3=m
CONFIG_FB_RADEON=y
CONFIG_FIRMWARE_EDID=y
CONFIG_FRAMEBUFFER_CONSOLE=y
CONFIG_FS_DAX=y
CONFIG_FTRACE=y
CONFIG_FTRACE_SYSCALLS=y
CONFIG_FTR_FIXUP_SELFTEST=y
CONFIG_FUNCTION_GRAPH_TRACER=y
CONFIG_FUNCTION_TRACER=y
CONFIG_FUSE_FS=m
CONFIG_GELIC_NET=m
CONFIG_GELIC_WIRELESS=y
CONFIG_HARDLOCKUP_DETECTOR=y
CONFIG_HFSPLUS_FS=m
CONFIG_HFS_FS=m
CONFIG_HID_GYRATION=y
CONFIG_HID_PANTHERLORD=y
CONFIG_HID_PETALYNX=y
CONFIG_HID_SAMSUNG=y
CONFIG_HID_SUNPLUS=y
CONFIG_HIGH_RES_TIMERS=y
CONFIG_HOTPLUG_CPU=y
CONFIG_HOTPLUG_PCI=y
CONFIG_HOTPLUG_PCI_RPA=m
CONFIG_HOTPLUG_PCI_RPA_DLPAR=m
CONFIG_HUGETLBFS=y
CONFIG_HVCS=m
CONFIG_HVC_CONSOLE=y
CONFIG_HVC_RTAS=y
CONFIG_HZ_100=y
CONFIG_I2C_AMD8111=y
CONFIG_I2C_CHARDEV=y
CONFIG_I2C_PASEMI=y
CONFIG_I40E=m
CONFIG_IBMEBUS=y
CONFIG_IBMVETH=m
CONFIG_IBM_BSR=m
CONFIG_IDE=y
CONFIG_IKCONFIG=y
CONFIG_IKCONFIG_PROC=y
CONFIG_INET=y
CONFIG_INET_AH=m
CONFIG_INET_ESP=m
CONFIG_INET_IPCOMP=m
CONFIG_INFINIBAND=m
CONFIG_INFINIBAND_CXGB3=m
CONFIG_INFINIBAND_CXGB4=m
CONFIG_INFINIBAND_IPOIB=m
CONFIG_INFINIBAND_IPOIB_CM=y
CONFIG_INFINIBAND_ISER=m
CONFIG_INFINIBAND_MTHCA=m
CONFIG_INFINIBAND_SRP=m
CONFIG_INFINIBAND_USER_ACCESS=m
CONFIG_INFINIBAND_USER_MAD=m
CONFIG_INPUT_EVDEV=m
CONFIG_INPUT_MISC=y
CONFIG_INPUT_PCSPKR=m
CONFIG_IPMI_DEVICE_INTERFACE=y
CONFIG_IPMI_HANDLER=y
CONFIG_IPMI_POWERNV=y
CONFIG_IP_MULTICAST=y
CONFIG_IP_PNP=y
CONFIG_IP_PNP_BOOTP=y
CONFIG_IP_PNP_DHCP=y
CONFIG_IRQ_ALL_CPUS=y
CONFIG_ISO9660_FS=y
CONFIG_IXGB=m
CONFIG_IXGBE=m
CONFIG_JFS_FS=m
CONFIG_JFS_POSIX_ACL=y
CONFIG_JFS_SECURITY=y
CONFIG_JUMP_LABEL=y
CONFIG_KEXEC=y
CONFIG_KEXEC_FILE=y
CONFIG_KPROBES=y
CONFIG_KSM=y
CONFIG_KVM_BOOK3S_64=m
CONFIG_KVM_BOOK3S_64_HV=m
CONFIG_LATENCYTOP=y
CONFIG_LCD_CLASS_DEVICE=y
CONFIG_LCD_PLATFORM=m
CONFIG_LEDS_CLASS=m
CONFIG_LEDS_POWERNV=m
CONFIG_LOGO=y
CONFIG_LOG_BUF_SHIFT=18
CONFIG_LOG_CPU_MAX_BUF_SHIFT=13
CONFIG_MACVLAN=m
CONFIG_MACVTAP=m
CONFIG_MAGIC_SYSRQ=y
CONFIG_MARVELL_PHY=y
CONFIG_MAX_RAW_DEVS=1024
CONFIG_MD=y
CONFIG_MD_FAULTY=m
CONFIG_MD_LINEAR=y
CONFIG_MD_MULTIPATH=m
CONFIG_MD_RAID0=y
CONFIG_MD_RAID10=m
CONFIG_MD_RAID1=y
CONFIG_MD_RAID456=m
CONFIG_MEMCG=y
CONFIG_MEMCG_SWAP=y
CONFIG_MEMORY_HOTPLUG=y
CONFIG_MEMORY_HOTREMOVE=y
CONFIG_MLX4_EN=m
CONFIG_MLX4_INFINIBAND=m
CONFIG_MODULES=y
CONFIG_MODULE_SRCVERSION_ALL=y
CONFIG_MODULE_UNLOAD=y
CONFIG_MODVERSIONS=y
CONFIG_MSDOS_FS=y
CONFIG_MSI_BITMAP_SELFTEST=y
CONFIG_MTD=y
CONFIG_MTD_BLOCK=y
CONFIG_MTD_POWERNV_FLASH=y
CONFIG_MYRI10GE=m
CONFIG_NET=y
CONFIG_NETCONSOLE=y
CONFIG_NETFILTER=y
CONFIG_NETXEN_NIC=m
CONFIG_NET_ACT_BPF=m
CONFIG_NET_CLS_ACT=y
CONFIG_NET_CLS_BPF=m
CONFIG_NET_IPIP=y
CONFIG_NET_KEY=m
CONFIG_NET_SCHED=y
CONFIG_NEW_LEDS=y
CONFIG_NFSD=m
CONFIG_NFSD_V3_ACL=y
CONFIG_NFSD_V4=y
CONFIG_NFS_FS=y
CONFIG_NFS_V3_ACL=y
CONFIG_NFS_V4=y
CONFIG_NILFS2_FS=m
CONFIG_NLS_ASCII=y
CONFIG_NLS_CODEPAGE_437=y
CONFIG_NLS_DEFAULT="utf8"
CONFIG_NLS_ISO8859_1=y
CONFIG_NLS_UTF8=y
CONFIG_NO_HZ=y
CONFIG_NR_CPUS=2048
CONFIG_NUMA=y
CONFIG_NUMA_BALANCING=y
CONFIG_OPAL_PRD=y
CONFIG_OPROFILE=m
CONFIG_OVERLAY_FS=m
CONFIG_PACKET=y
CONFIG_PARPORT=m
CONFIG_PARPORT_PC=m
CONFIG_PARTITION_ADVANCED=y
CONFIG_PASEMI_MAC=y
CONFIG_PATA_AMD=y
CONFIG_PATA_MACIO=y
CONFIG_PCCARD=y
CONFIG_PCNET32=m
CONFIG_PM=y
CONFIG_PMAC_SMU=y
CONFIG_POSIX_MQUEUE=y
CONFIG_PPC64=y
CONFIG_PPC_64K_PAGES=y
CONFIG_PPC_EARLY_DEBUG=y
CONFIG_PPC_EMULATED_STATS=y
CONFIG_PPC_IBM_CELL_BLADE=y
CONFIG_PPC_MAPLE=y
CONFIG_PPC_PASEMI=y
CONFIG_PPC_PASEMI_IOMMU=y
CONFIG_PPC_PS3=y
CONFIG_PPC_SMLPAR=y
CONFIG_PPC_SPLPAR=y
CONFIG_PPC_SUBPAGE_PROT=y
CONFIG_PPC_TRANSACTIONAL_MEM=y
CONFIG_PPP=m
CONFIG_PPPOE=m
CONFIG_PPP_ASYNC=m
CONFIG_PPP_BSDCOMP=m
CONFIG_PPP_DEFLATE=m
CONFIG_PPP_SYNC_TTY=m
CONFIG_PROC_KCORE=y
CONFIG_PROFILING=y
CONFIG_PS3_DISK=m
CONFIG_PS3_FLASH=m
CONFIG_PS3_LPM=m
CONFIG_PS3_ROM=m
CONFIG_PSTORE=y
CONFIG_QLGE=m
CONFIG_RAS=y
CONFIG_RAW_DRIVER=y
CONFIG_REISERFS_FS=m
CONFIG_REISERFS_FS_POSIX_ACL=y
CONFIG_REISERFS_FS_SECURITY=y
CONFIG_REISERFS_FS_XATTR=y
CONFIG_ROOT_NFS=y
CONFIG_RTAS_FLASH=m
CONFIG_RTC_CLASS=y
CONFIG_RTC_DRV_DS1307=y
CONFIG_RTC_DRV_GENERIC=y
CONFIG_S2IO=m
CONFIG_SATA_AHCI=y
CONFIG_SATA_MV=y
CONFIG_SATA_SIL24=y
CONFIG_SATA_SVW=y
CONFIG_SCANLOG=m
CONFIG_SCHED_SMT=y
CONFIG_SCHED_TRACER=y
CONFIG_SCSI_AACRAID=y
CONFIG_SCSI_BNX2_ISCSI=m
CONFIG_SCSI_CONSTANTS=y
CONFIG_SCSI_CXGB3_ISCSI=m
CONFIG_SCSI_CXGB4_ISCSI=m
CONFIG_SCSI_DH=y
CONFIG_SCSI_DH_ALUA=m
CONFIG_SCSI_DH_RDAC=m
CONFIG_SCSI_FC_ATTRS=y
CONFIG_SCSI_IBMVFC=m
CONFIG_SCSI_IBMVSCSI=y
CONFIG_SCSI_IPR=y
CONFIG_SCSI_LPFC=m
CONFIG_SCSI_MPT2SAS=m
CONFIG_SCSI_QLA_FC=m
CONFIG_SCSI_QLA_ISCSI=m
CONFIG_SCSI_SRP_ATTRS=y
CONFIG_SCSI_SYM53C8XX_2=m
CONFIG_SCSI_SYM53C8XX_DMA_ADDRESSING_MODE=0
CONFIG_SCSI_VIRTIO=m
CONFIG_SERIAL_8250=y
CONFIG_SERIAL_8250_CONSOLE=y
CONFIG_SERIAL_ICOM=m
CONFIG_SERIAL_JSM=m
CONFIG_SND=m
CONFIG_SND_AOA=m
CONFIG_SND_AOA_FABRIC_LAYOUT=m
CONFIG_SND_AOA_ONYX=m
CONFIG_SND_AOA_TAS=m
CONFIG_SND_AOA_TOONIE=m
CONFIG_SND_MIXER_OSS=m
CONFIG_SND_OSSEMUL=y
CONFIG_SND_PCM_OSS=m
CONFIG_SND_POWERMAC=m
CONFIG_SND_SEQUENCER=m
CONFIG_SND_SEQUENCER_OSS=m
CONFIG_SND_SEQ_DUMMY=m
CONFIG_SOFTLOCKUP_DETECTOR=y
CONFIG_SOUND=m
CONFIG_SPIDER_NET=m
CONFIG_SQUASHFS=m
CONFIG_SQUASHFS_LZO=y
CONFIG_SQUASHFS_XATTR=y
CONFIG_SQUASHFS_XZ=y
CONFIG_SUNGEM=y
CONFIG_SYN_COOKIES=y
CONFIG_SYSVIPC=y
CONFIG_TASKSTATS=y
CONFIG_TASK_DELAY_ACCT=y
CONFIG_TASK_IO_ACCOUNTING=y
CONFIG_TASK_XACCT=y
CONFIG_TIGON3=y
CONFIG_TMPFS=y
CONFIG_TMPFS_POSIX_ACL=y
CONFIG_TRANSPARENT_HUGEPAGE=y
CONFIG_TUN=m
CONFIG_UDF_FS=m
CONFIG_UEVENT_HELPER_PATH="/sbin/hotplug"
CONFIG_UNIX=y
CONFIG_USB=y
CONFIG_USB_APPLEDISPLAY=m
CONFIG_USB_EHCI_HCD=y
CONFIG_USB_HIDDEV=y
CONFIG_USB_MON=m
CONFIG_USB_OHCI_HCD=y
CONFIG_USB_STORAGE=m
CONFIG_USB_XHCI_HCD=y
CONFIG_USER_NS=y
CONFIG_VETH=m
CONFIG_VFAT_FS=m
CONFIG_VHOST_NET=m
CONFIG_VIRTIO_BALLOON=m
CONFIG_VIRTIO_BLK=m
CONFIG_VIRTIO_CONSOLE=m
CONFIG_VIRTIO_NET=m
CONFIG_VIRTIO_PCI=m
CONFIG_VIRTUALIZATION=y
CONFIG_VLAN_8021Q=m
CONFIG_VORTEX=m
CONFIG_VXLAN=m
CONFIG_WINDFARM=y
CONFIG_WINDFARM_PM112=y
CONFIG_WINDFARM_PM121=y
CONFIG_WINDFARM_PM81=y
CONFIG_WINDFARM_PM91=y
CONFIG_XFRM_USER=m
CONFIG_XFS_FS=m
CONFIG_XFS_POSIX_ACL=y
CONFIG_XMON=y
```
